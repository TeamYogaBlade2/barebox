## arch/arm/configs/mediatek_v8_defconfig
```kconfig
CONFIG_ARCH_MEDIATEK=y
CONFIG_ARM_OPTIMZED_STRING_FUNCTIONS=y
CONFIG_ARM_PSCI_CLIENT=y
CONFIG_BOARD_GENERIC_FIT=y
CONFIG_NAME="mediatek_v8_defconfig"
CONFIG_MMU=y
CONFIG_KALLSYMS=y
CONFIG_PROMPT="barebox> "
CONFIG_HUSH_FANCY_PROMPT=y
CONFIG_AUTO_COMPLETE=y
CONFIG_MENU=y
CONFIG_BOOTM_SHOW_TYPE=y
CONFIG_BOOTM_VERBOSE=y
CONFIG_BOOTM_INITRD=y
CONFIG_BOOTM_OFTREE_UIMAGE=y
CONFIG_BOOTM_AIMAGE=y
CONFIG_BOOTM_FITIMAGE=y
CONFIG_BLSPEC=y
CONFIG_CONSOLE_ALLOW_COLOR=y
CONFIG_PBL_CONSOLE=y
CONFIG_CONSOLE_RATP=y
CONFIG_PARTITION_DISK_EFI=y
CONFIG_DEFAULT_ENVIRONMENT_GENERIC_NEW=y
CONFIG_TLV=y
CONFIG_STATE=y
CONFIG_BOOTCHOOSER=y
CONFIG_RESET_SOURCE=y
CONFIG_MACHINE_ID=y
CONFIG_FASTBOOT_SPARSE=y
CONFIG_EFI_LOADER=y
CONFIG_CMD_DMESG=y
CONFIG_LONGHELP=y
CONFIG_CMD_IOMEM=y
CONFIG_CMD_IMD=y
CONFIG_CMD_MEMINFO=y
CONFIG_CMD_ARM_MMUINFO=y
CONFIG_CMD_REGULATOR=y
CONFIG_CMD_VARINFO=y
CONFIG_CMD_BFETCH=y
CONFIG_CMD_MMC_EXTCSD=y
CONFIG_CMD_POLLER=y
CONFIG_CMD_SLICE=y
CONFIG_CMD_GO=y
CONFIG_CMD_LOADB=y
CONFIG_CMD_RESET=y
CONFIG_CMD_UIMAGE=y
CONFIG_CMD_BOOTCHOOSER=y
CONFIG_CMD_PARTITION=y
CONFIG_CMD_FINDMNT=y
CONFIG_CMD_EXPORT=y
CONFIG_CMD_DEFAULTENV=y
CONFIG_CMD_LOADENV=y
CONFIG_CMD_PRINTENV=y
CONFIG_CMD_MAGICVAR=y
CONFIG_CMD_MAGICVAR_HELP=y
CONFIG_CMD_SAVEENV=y
CONFIG_CMD_FILETYPE=y
CONFIG_CMD_LN=y
CONFIG_CMD_MD5SUM=y
CONFIG_CMD_SHA1SUM=y
CONFIG_CMD_SHA224SUM=y
CONFIG_CMD_SHA256SUM=y
CONFIG_CMD_BASE64=y
CONFIG_CMD_UNCOMPRESS=y
CONFIG_CMD_LET=y
CONFIG_CMD_MSLEEP=y
CONFIG_CMD_READF=y
CONFIG_CMD_SLEEP=y
CONFIG_CMD_DHCP=y
CONFIG_CMD_MIITOOL=y
CONFIG_CMD_PING=y
CONFIG_CMD_TFTP=y
CONFIG_CMD_ECHO_E=y
CONFIG_CMD_EDIT=y
CONFIG_CMD_MENU=y
CONFIG_CMD_MENU_MANAGEMENT=y
CONFIG_CMD_MENUTREE=y
CONFIG_CMD_SPLASH=y
CONFIG_CMD_FBTEST=y
CONFIG_CMD_READLINE=y
CONFIG_CMD_TIMEOUT=y
CONFIG_CMD_CRC=y
CONFIG_CMD_CRC_CMP=y
CONFIG_CMD_MEMTEST=y
CONFIG_CMD_MM=y
CONFIG_CMD_CLK=y
CONFIG_CMD_DETECT=y
CONFIG_CMD_FLASH=y
CONFIG_CMD_GPIO=y
CONFIG_CMD_LED=y
CONFIG_CMD_POWEROFF=y
CONFIG_CMD_SMC=y
CONFIG_CMD_LED_TRIGGER=y
CONFIG_CMD_USBGADGET=y
CONFIG_CMD_WD=y
CONFIG_CMD_LOGIN=y
CONFIG_CMD_PASSWD=y
CONFIG_CMD_BAREBOX_UPDATE=y
CONFIG_CMD_FIRMWARELOAD=y
CONFIG_CMD_OF_DIFF=y
CONFIG_CMD_OF_NODE=y
CONFIG_CMD_OF_PROPERTY=y
CONFIG_CMD_OF_DISPLAY_TIMINGS=y
CONFIG_CMD_OF_FIXUP_STATUS=y
CONFIG_CMD_OF_OVERLAY=y
CONFIG_CMD_OFTREE=y
CONFIG_CMD_TIME=y
CONFIG_CMD_WATCH=y
CONFIG_CMD_TLV=y
CONFIG_NET=y
CONFIG_NET_NETCONSOLE=y
CONFIG_NET_SNTP=y
CONFIG_NET_FASTBOOT=y
CONFIG_NET_9P=y
CONFIG_DEEP_PROBE_DEFAULT=y
CONFIG_OF_BAREBOX_DRIVERS=y
CONFIG_OF_BAREBOX_ENV_IN_FS=y
CONFIG_OF_OVERLAY_LIVE=y
CONFIG_SERIAL_DEV_BUS=y
CONFIG_SERIAL_AMBA_PL011=y
CONFIG_DRIVER_SERIAL_NS16550=y
CONFIG_DRIVER_SERIAL_CADENCE=y
CONFIG_NET_USB=y
CONFIG_NET_USB_ASIX=y
CONFIG_USB_NET_AX88179_178A=y
CONFIG_NET_USB_SMSC95XX=y
CONFIG_NET_USB_RTL8152=y
CONFIG_MTD=y
CONFIG_MTD_CONCAT=y
CONFIG_DRIVER_CFI=y
CONFIG_CFI_BUFFER_WRITE=y
CONFIG_USB_HOST=y
CONFIG_USB_DWC3=y
CONFIG_USB_DWC3_DUAL_ROLE=y
CONFIG_USB_EHCI=y
CONFIG_USB_STORAGE=y
CONFIG_USB_ONBOARD_DEV=y
CONFIG_USB_GADGET=y
CONFIG_USB_GADGET_SERIAL=y
CONFIG_USB_GADGET_FASTBOOT=y
CONFIG_USB_GADGET_MASS_STORAGE=y
CONFIG_VIDEO=y
CONFIG_FRAMEBUFFER_CONSOLE=y
CONFIG_DRIVER_VIDEO_BACKLIGHT=y
CONFIG_DRIVER_VIDEO_BACKLIGHT_PWM=y
CONFIG_SOUND=y
CONFIG_MCI=y
CONFIG_MCI_STARTUP=y
CONFIG_MCI_MTK=y
CONFIG_COMMON_CLK_SCMI=y
CONFIG_LED=y
CONFIG_LED_GPIO=y
CONFIG_LED_GPIO_OF=y
CONFIG_LED_TRIGGERS=y
CONFIG_EEPROM_AT25=y
CONFIG_WATCHDOG=y
CONFIG_WATCHDOG_POLLER=y
CONFIG_WATCHDOG_DW=y
CONFIG_PWM=y
CONFIG_HWRNG=y
CONFIG_DMADEVICES=y
CONFIG_PINCTRL_SINGLE=y
CONFIG_REGULATOR_FIXED=y
CONFIG_REGULATOR_ARM_SCMI=y
CONFIG_PCI_ECAM_GENERIC=y
CONFIG_RTC_CLASS=y
CONFIG_ARM_SCMI_PROTOCOL=y
CONFIG_GENERIC_PHY=y
CONFIG_USB_NOP_XCEIV=y
# CONFIG_VIRTIO_MENU is not set
CONFIG_MAILBOX=y
CONFIG_FS_CRAMFS=y
CONFIG_FS_EXT4=y
CONFIG_FS_TFTP=y
CONFIG_FS_NFS=y
CONFIG_9P_FS=y
CONFIG_9P_FS_WRITE=y
CONFIG_FS_FAT=y
CONFIG_FS_FAT_WRITE=y
CONFIG_FS_BPKFS=y
CONFIG_FS_UIMAGEFS=y
CONFIG_FS_PSTORE=y
CONFIG_FS_PSTORE_CONSOLE=y
CONFIG_FS_SQUASHFS=y
CONFIG_FS_RATP=y
CONFIG_DIGEST_SHA1_ARM64_CE=y
CONFIG_DIGEST_SHA256_ARM64_CE=y
CONFIG_ZSTD_DECOMPRESS=y
CONFIG_XZ_DECOMPRESS=y
CONFIG_LZO_DECOMPRESS=y
CONFIG_FONT_8x16=y
CONFIG_FONT_TER16x32=y
# CONFIG_MISSING_FIRMWARE_ERROR is not set
```

## arch/arm/configs/mt6589-2nd_defconfig
```kconfig
CONFIG_ARCH_MEDIATEK=y
CONFIG_ARCH_MT6589=y
CONFIG_ARM_APPENDED_DTB=y
CONFIG_ARM_APPENDED_DTB_NAME="mediatek/mt6589-lenovo-b8000-f.dtb"
CONFIG_ARM_ARCH_TIMER=y
CONFIG_ARM_GIC=y
CONFIG_BANNER=y
CONFIG_BAREBOXENV_TARGET=y
CONFIG_BOARD_GENERIC_DT=y
CONFIG_CLK=y
CONFIG_CLKSRC_ARM_ARCH_TIMER=y
CONFIG_CLOCKSOURCE_MEDIATEK=y
CONFIG_CMD_BOOTM=y
CONFIG_CMD_BOOTZ=y
CONFIG_CMD_CRC=y
CONFIG_CMD_DETECT=y
CONFIG_CMD_DEVINFO=y
CONFIG_CMD_ECHO=y
CONFIG_CMD_EXIT=y
CONFIG_CMD_EXPORT=y
CONFIG_CMD_FALSE=y
CONFIG_CMD_GLOBAL=y
CONFIG_CMD_GO=y
CONFIG_CMD_GPIO=y
CONFIG_CMD_HELP=y
CONFIG_CMD_I2C=y
CONFIG_CMD_IMPORT=y
CONFIG_CMD_LOADB=y
CONFIG_CMD_LOADY=y
CONFIG_CMD_LOGIN=y
CONFIG_CMD_MD5SUM=y
CONFIG_CMD_MEM=y
CONFIG_CMD_MEMINFO=y
CONFIG_CMD_OF_DUMP=y
CONFIG_CMD_OF_NODE=y
CONFIG_CMD_OF_PROPERTY=y
CONFIG_CMD_PRINTENV=y
CONFIG_CMD_REGULATOR=y
CONFIG_CMD_RESET=y
CONFIG_CMD_SAVEENV=y
CONFIG_CMD_SLEEP=y
CONFIG_CMD_TIME=y
CONFIG_CMD_TIMEOUT=y
CONFIG_CMD_TRUE=y
CONFIG_CMD_VERSION=y
CONFIG_COMMON_CLK=y
CONFIG_COMMON_CLK_MT6589=y
CONFIG_CONSOLE_SIMPLE=y
CONFIG_CPU_V7=y
CONFIG_CRC32=y
CONFIG_DEBUG_LL=y
CONFIG_DEBUG_MTK_UART=y
CONFIG_DEFAULT_ENVIRONMENT_GENERIC=y
CONFIG_DEFAULT_ENVIRONMENT_GENERIC_NEW=y
CONFIG_DRIVER_SERIAL_NS16550=y
CONFIG_DRIVER_VIDEO=y
CONFIG_DRIVER_VIDEO_SIMPLEFB=y
CONFIG_DRIVER_VIDEO_SIMPLEFB_CLIENT=y
CONFIG_FS_CRAMFS=y
CONFIG_FS_FAT=y
CONFIG_GENERIC_PHY=y
CONFIG_GLOBALVAR=y
CONFIG_GPIO=y
CONFIG_GPIOLIB=y
CONFIG_HUSH=y
CONFIG_IMAGE_GZIP=y
CONFIG_IMAGE_LZ4=y
CONFIG_INPUT=y
CONFIG_INPUT_MATRIXKMAP=y
CONFIG_KEYBOARD=y
CONFIG_KEYBOARD_MTK=y
CONFIG_LZ4=y
CONFIG_MCI=y
CONFIG_MCI_MTK_SD=y
CONFIG_MD5=y
CONFIG_MFD_MT6320=y
CONFIG_MFD_MTK_PWRAP=y
CONFIG_OFDEVICE=y
CONFIG_OF_BAREBOX_DRIVERS=y
CONFIG_PARTITION=y
CONFIG_PASSWORD=y
CONFIG_PASSWORD_PBKDF2=y
CONFIG_PHY_MTK_TPHY=y
CONFIG_PINCTRL=y
CONFIG_PINCTRL_MT6589=y
CONFIG_PROMPT="barebox@mt6589> "
CONFIG_REGMAP=y
CONFIG_REGULATOR=y
CONFIG_REGULATOR_MT6320=y
CONFIG_RTC_CLASS=y
CONFIG_RTC_MT6320=y
CONFIG_SERIAL_MEDIATEK=y
CONFIG_USB=y
CONFIG_USB_MUSB=y
CONFIG_USB_MUSB_HOST=y
CONFIG_USB_MUSB_MEDIATEK=y
CONFIG_WATCHDOG=y
CONFIG_WATCHDOG_MTK=y
CONFIG_WATCHDOG_POLLER=y
CONFIG_ZLIB=y
```

## arch/arm/mach-mediatek/Kconfig
```kconfig
# SPDX-License-Identifier: GPL-2.0-only

menu "Mediatek SoCs"
        depends on ARCH_MEDIATEK

config ARCH_MT6589
	bool "MediaTek MT6589"
	select CPU_V7
	help
	  Support for MediaTek MT6589 SoC (used as secondary bootloader after
	  preloader/LK which initializes DRAM and framebuffer).

config ARCH_MEDIATEK_V8
	bool
	select CPU_V8
	select CPU_SUPPORTS_64BIT_KERNEL
	select CLOCKSOURCE_ARM_ARCHITECTED_TIMER

config ARCH_MT81XX
	bool "Mediatek MT81XX SoCs"
	select ARCH_MEDIATEK_V8
	depends on 64BIT
	default y
	help
	  Enables support for various Mediatek SoCs used in Chromebooks

endmenu
```

## drivers/clk/mediatek/Kconfig
```kconfig
# SPDX-License-Identifier: GPL-2.0-only
#
# MediaTek Clock Drivers
#
menu "Clock driver for MediaTek SoC"
	depends on ARCH_MEDIATEK || COMPILE_TEST

config COMMON_CLK_MEDIATEK
	tristate
	select RESET_CONTROLLER
	select MFD_SYSCON
	help
	  MediaTek SoCs' clock support.

config COMMON_CLK_MEDIATEK_FHCTL
	bool "clock driver for MediaTek FHCTL hardware control"
	select COMMON_CLK_MEDIATEK
	help
	  This driver supports MediaTek frequency hopping and
	  spread spectrum clocking features.

config COMMON_CLK_MT8186
	tristate "Clock driver for MediaTek MT8186"
	depends on ARM64 || COMPILE_TEST
	select COMMON_CLK_MEDIATEK
	select COMMON_CLK_MEDIATEK_FHCTL
	default ARCH_MEDIATEK
	help
	  This driver supports MediaTek MT8186 clocks.

config COMMON_CLK_MT8195
	tristate "Clock driver for MediaTek MT8195"
	depends on ARM64 || COMPILE_TEST
	select COMMON_CLK_MEDIATEK
	select COMMON_CLK_MEDIATEK_FHCTL
	default ARCH_MEDIATEK
	help
	  This driver supports MediaTek MT8195 clocks.

endmenu
```

## drivers/pinctrl/mediatek/Kconfig
```kconfig
# SPDX-License-Identifier: GPL-2.0-only
menu "Pin controllers for MediaTek SoCs"
	depends on ARCH_MEDIATEK || COMPILE_TEST

config PINCTRL_MEDIATEK
	bool
	help
		MediaTek pin controller support

config PINCTRL_MTK_PARIS
	bool
	select PINCTRL_MEDIATEK
	select PINCTRL_GENERIC
	# select HAVE_GPIO_PINCONF

config PINCTRL_MT8183
	bool "MediaTek MT8183 pin control"
	default ARCH_MT81XX
	select PINCTRL_MTK_PARIS

config PINCTRL_MT8186
	bool "MediaTek MT8186 pin control"
	default ARCH_MT81XX
	select PINCTRL_MTK_PARIS

config PINCTRL_MT8188
	bool "MediaTek MT8188 pin control"
	default ARCH_MT81XX
	select PINCTRL_MTK_PARIS

config PINCTRL_MT8189
	bool "MediaTek MT8189 pin control"
	default ARCH_MT81XX
	select PINCTRL_MTK_PARIS

config PINCTRL_MT8192
	bool "MediaTek MT8192 pin control"
	default ARCH_MT81XX
	select PINCTRL_MTK_PARIS

config PINCTRL_MT8195
	bool "MediaTek MT8195 pin control"
	default ARCH_MT81XX
	select PINCTRL_MTK_PARIS

config PINCTRL_MT8196
	bool "MediaTek MT8196 pin control"
	default ARCH_MT81XX
	select PINCTRL_MTK_PARIS

endmenu
```

## drivers/pmdomain/Kconfig
```kconfig
# SPDX-License-Identifier: GPL-2.0-only
menu "PM Domains"

source "drivers/pmdomain/imx/Kconfig"
source "drivers/pmdomain/rockchip/Kconfig"
source "drivers/pmdomain/ti/Kconfig"

config MTK_PM_DOMAINS
	bool "MediaTek power domains"
	depends on ARCH_MEDIATEK || COMPILE_TEST

endmenu
```
